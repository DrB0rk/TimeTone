## firmware/sdkconfig.defaults
```kconfig
CONFIG_IDF_TARGET="esp32"
CONFIG_ESPTOOLPY_FLASHSIZE_4MB=y
CONFIG_ESPTOOLPY_FLASHSIZE="4MB"
CONFIG_PARTITION_TABLE_CUSTOM=y
CONFIG_PARTITION_TABLE_CUSTOM_FILENAME="partitions.csv"
CONFIG_ESP_TLS_USE_SECURE_ELEMENT=n
CONFIG_MBEDTLS_CERTIFICATE_BUNDLE=y
CONFIG_LV_COLOR_DEPTH_16=y
CONFIG_LV_USE_BUTTONMATRIX=y
CONFIG_LV_USE_LABEL=y
CONFIG_LV_USE_SPINNER=y
CONFIG_COMPILER_OPTIMIZATION_PERF=y
```
